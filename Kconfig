## Kconfig
```kconfig
menu "MTFTP Configuration"
    config WINDOW_SIZE
        int "Window Size"
        default 32
        range 1 65535
        help
        Number of blocks to transfer in a single window
    config LEN_BLOCK
        int "Block Size"
        default 247
        range 1 247
        help
        Size of one block of data (bytes)
    config TIMEOUT_CLIENT
        int "Initial Client Timeout (us)"
        default 20000
        range 1 10000000
        help
        Client attempts to resend RTX/ACK after this timeout
    config TIMEOUT
        int "Overall Timeout (us)"
        default 100000
        range 1 10000000
        help
        System times out after time in microseconds
    config LEN_MTFTP_BUFFER
        int "Block Buffer"
        default 32
        range 1 128
        help
        Number of blocks to buffer on the client in the event of missing data packets
    config LEN_PACKET_BUFFER
        int "Packet Buffer"
        default 16384
        range 1024 16384
        help
        Length of the buffer to store raw received packets from the ESP-NOW ISR
endmenu
```
